## drivers/dma/Kconfig.gecko
```kconfig
# Silabs Gecko DMAC driver configuration options

# Copyright (c) 2022 Kai Meinhard
# SPDX-License-Identifier: Apache-2.0

config DMA_GECKO
	bool "Silabs Gecko DMA driver"
	depends on SOC_FAMILY_EXX32
	depends on DMA
	help
	  Enable Silabs Gecko MCU Family (EXX32) Direct Memory Access driver.
```

## drivers/serial/Kconfig.gecko
```kconfig
# Gecko SDK UART

# Copyright (c) 2017, Christian Taedcke
# SPDX-License-Identifier: Apache-2.0

config UART_GECKO
	bool "Gecko UART/USART driver"
	default y
	depends on DT_HAS_SILABS_GECKO_UART_ENABLED || DT_HAS_SILABS_GECKO_USART_ENABLED
	select SERIAL_HAS_DRIVER
	select SERIAL_SUPPORT_INTERRUPT
	select SOC_GECKO_USART
	select PINCTRL if SOC_GECKO_SERIES1
	help
	  Enable the Gecko uart driver.

# TODO better depends on for EMDRV
config UART_GECKO_DMA
	bool "Gecko UART/USART DMA driver"
	depends on HAS_SILABS_GECKO
	depends on GPIO_GECKO
	select DMA
	select DMA_GECKO
	select SERIAL_HAS_DRIVER
	select SERIAL_SUPPORT_INTERRUPT
	select SOC_GECKO_USART
	select UART_GECKO
	help
	  Enable the Gecko uart driver.

if UART_GECKO_DMA
config UART_GECKO_DMA_QUEUE
	int "DMA Queue size"
	default 2
	depends on UART_GECKO_DMA
	help
	  Size of the queue of DMA buffers, does not effect DMA buffer size
endif
```
